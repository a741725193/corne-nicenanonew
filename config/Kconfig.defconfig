## config/Kconfig.defconfig
```kconfig
config BOARD_ENABLE_DCDC
    bool "Enable DCDC mode"
    select SOC_DCDC_NRF52X
    default y
    depends on ( BOARD_CORNE_LEFT || BOARD_CORNE_RIGHT)

config BOARD_ENABLE_DCDC_HV
    bool "Enable High Voltage DCDC converter"
    default y
    select SOC_DCDC_NRF52X_HV
    depends on ( BOARD_CORNE_LEFT || BOARD_CORNE_RIGHT)
config BT_CTLR
    default BT

if USB

config USB_NRFX
    default y
```
